VERSION ""

NS_ :

BS_:

BU_:

BO_ 1537 GatewayStatus: 2 Vector__XXX
 SG_ flags : 8|16@1+ (1,0) [0|0] "" Vector__XXX
 SG_ GatewayState : 0|8@1- (1,0) [-128|127] "" Vector__XXX
